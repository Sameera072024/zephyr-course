## app/boards/hello_world_copy_method/Kconfig
```kconfig
# Copyright 2025 NXP
# SPDX-License-Identifier: Apache-2.0

config BOARD_HELLO_WORLD_COPY_METHOD
	select BOARD_EARLY_INIT_HOOK
```

## app/boards/hello_world_copy_method/Kconfig.hello_world_copy_method
```kconfig
# Copyright 2025 NXP
# SPDX-License-Identifier: Apache-2.0

config BOARD_HELLO_WORLD_COPY_METHOD
	select SOC_MCXA153 if BOARD_HELLO_WORLD_COPY_METHOD
	select SOC_PART_NUMBER_MCXA153VLH
```

## app/boards/hello_world_copy_method/board.yml
```yaml
board:
  name: hello_world_copy_method
  full_name: Hello World Copy Method
  vendor: IOMICO
  socs:
  - name: mcxa153
```

## app/boards/hello_world_scratch_method/Kconfig.hello_world_scratch_method
```kconfig
config BOARD_HELLO_WORLD_SCRATCH_METHOD
	select SOC_MCXA153 if BOARD_HELLO_WORLD_SCRATCH_METHOD
	select SOC_PART_NUMBER_MCXA153VLH
```

## app/boards/hello_world_scratch_method/board.yml
```yaml
board:
  name: hello_world_scratch_method
  full_name: Hello world from scratch
  vendor: IOMICO
  socs:
  - name: mcxa153
```

## app/boards/my_board/Kconfig.my_board
```kconfig
config BOARD_MY_BOARD
	select SOC_MCXA153 if BOARD_MY_BOARD
	select SOC_PART_NUMBER_MCXA153VLH
```

## app/boards/my_board/board.yml
```yaml
board:
  name: my_board
  full_name: My board from scratch
  vendor: IOMICO
  socs:
  - name: mcxa153
```

## app/boards/our_board/board.yml
```yaml
board:
  name: our_board
  full_name: Our board
  vendor: IOMICO
  socs:
  - name: mcxa153
```
